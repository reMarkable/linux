## drivers/mxc/Kconfig
```kconfig
# drivers/mxc/Kconfig

if ARCH_MXC

menu "MXC support drivers"

# drivers common to MXC and MX8 go here:

if ARM64
source "drivers/mxc/hantro/Kconfig"
source "drivers/mxc/vpu_malone/Kconfig"
source "drivers/mxc/vpu_windsor/Kconfig"
endif

endmenu

endif
```

## drivers/mxc/vpu_windsor/Kconfig
```kconfig
#
# Codec configuration
#

menu "MXC VPU(Video Processing Unit) WINDSOR ENCODER support"

config MXC_VPU_WINDSOR
	  tristate "Support for MXC VPU(Video Processing Unit) WINDSOR ENCODER"
	  depends on MEDIA_SUPPORT
	  depends on VIDEO_DEV
	  depends on VIDEO_V4L2
	  select VIDEOBUF2_DMA_CONTIG
	  select VIDEOBUF2_VMALLOC
	  default y
	---help---
	  The VPU codec device provides codec function for H.264 etc.

config MXC_VPU_WINDSOR_DEBUG
	bool "MXC VPU WINDSOR ENCODER debugging"
	depends on MXC_VPU_WINDSOR != n
	help
	  This is an option for the developers; most people should
	  say N here.  This enables MXC VPU WINDSOR Encoder driver debugging.

endmenu
```

## drivers/mxc/xuvi/Kconfig
```kconfig
#
# DVB device configuration
#

menu "XUVI/PPM HW TS filter and demux"
	depends on ARCH_MXC

config MXC_IMX_DMX_HW
	tristate "Enable HW Implementation based on XUVI/PPM"
	default y
	help
	  Hardware demux driver implementation using PPM

endmenu
```

## drivers/net/ethernet/freescale/dpaa2/Kconfig
```kconfig
# SPDX-License-Identifier: GPL-2.0-only
config FSL_DPAA2_ETH
	tristate "Freescale DPAA2 Ethernet"
	depends on FSL_MC_BUS && FSL_MC_DPIO
	help
	  This is the DPAA2 Ethernet driver supporting Freescale SoCs
	  with DPAA2 (DataPath Acceleration Architecture v2).
	  The driver manages network objects discovered on the Freescale
	  MC bus.

if FSL_DPAA2_ETH
config FSL_DPAA2_ETH_DCB
	bool "Data Center Bridging (DCB) Support"
	default n
	depends on DCB
	help
	  Enable Priority-Based Flow Control (PFC) support in the driver

config FSL_DPAA2_ETH_USE_ERR_QUEUE
	bool "Enable Rx error queue"
	default n
	help
	  Allow Rx error frames to be enqueued on an error queue
	  and processed by the driver (by default they are dropped
	  in hardware).
	  This may impact performance, recommended for debugging
	  purposes only.

config FSL_DPAA2_ETH_CEETM
	depends on NET_SCHED
	bool "DPAA2 Ethernet CEETM QoS"
	default n
	help
	  Enable QoS offloading support through the CEETM hardware block.
endif

config FSL_DPAA2_PTP_CLOCK
	tristate "Freescale DPAA2 PTP Clock"
	depends on FSL_DPAA2_ETH && PTP_1588_CLOCK_QORIQ
	default y
	help
	  This driver adds support for using the DPAA2 1588 timer module
	  as a PTP clock.
```

## drivers/net/wireless/nxp/mxm_wifiex/Kconfig
```kconfig
# SPDX-License-Identifier: GPL-2.0-only
#
# NXP Wireless device configuration
#
config MXMWIFIEX
	tristate "NXP MxM WiFi Driver"
	depends on CFG80211
	---help---
		This driver is multi-chip-multi-interface driver
		(indicating Multi-Chip x Multi-Interface support) based on
		NXP 802.11n/ac chipsets. If you choose to build it as a module,
		it will be build 2 modules moal.ko and mlan.ko.
```

## drivers/net/wireless/rtl8821au/Kconfig
```kconfig
config RTL8821AU
	tristate "Realtek 8821 USB WiFi"
	depends on USB
	depends on WEXT_CORE
	---help---
	  Help message of RTL8821AU
```

## drivers/pci/controller/mobiveil/Kconfig
```kconfig
# SPDX-License-Identifier: GPL-2.0

menu "Mobiveil PCIe Core Support"
	depends on PCI

config PCIE_MOBIVEIL
	bool

config PCIE_MOBIVEIL_HOST
        bool
	depends on PCI_MSI_IRQ_DOMAIN
        select PCIE_MOBIVEIL

config PCIE_MOBIVEIL_EP
	bool
	depends on PCI_ENDPOINT
	select PCIE_MOBIVEIL

config PCIE_MOBIVEIL_PLAT
	bool "Mobiveil AXI PCIe controller"
	depends on ARCH_ZYNQMP || COMPILE_TEST
	depends on OF
	select PCIE_MOBIVEIL_HOST
	help
	  Say Y here if you want to enable support for the Mobiveil AXI PCIe
	  Soft IP. It has up to 8 outbound and inbound windows
	  for address translation and it is a PCIe Gen4 IP.

config PCIE_LAYERSCAPE_GEN4
	bool "Freescale Layerscpe PCIe Gen4 controller in RC mode"
	depends on PCI
	depends on OF && (ARM64 || ARCH_LAYERSCAPE)
	depends on PCI_MSI_IRQ_DOMAIN
	select PCIE_MOBIVEIL_HOST
	help
	  Say Y here if you want PCIe Gen4 controller support on
	  Layerscape SoCs. And the PCIe controller work in RC mode
	  by setting the RCW[HOST_AGT_PEX] to 0.

config PCIE_LAYERSCAPE_GEN4_EP
	bool "Freescale Layerscpe PCIe Gen4 controller in EP mode"
	depends on PCI
	depends on OF && (ARM64 || ARCH_LAYERSCAPE)
	depends on PCI_ENDPOINT
	select PCIE_MOBIVEIL_EP
	help
	  Say Y here if you want PCIe Gen4 controller support on
	  Layerscape SoCs. And the PCIe controller work in EP mode
	  by setting the RCW[HOST_AGT_PEX] to 1.
endmenu
```

## drivers/staging/fsl-dpaa2/mac/Kconfig
```kconfig
config FSL_DPAA2_MAC
	tristate "DPAA2 MAC / PHY interface"
	depends on FSL_MC_BUS && FSL_DPAA2
	select MDIO_BUS_MUX_MMIOREG
	select FSL_XGMAC_MDIO
	select FIXED_PHY
	---help---
	Prototype driver for DPAA2 MAC / PHY interface object.
	This driver works as a proxy between phylib including phy drivers and
	the MC firmware.  It receives updates on link state changes from PHY
	lib and forwards them to MC and receives interrupt from MC whenever
	a request is made to change the link state.


config FSL_DPAA2_MAC_NETDEVS
	bool "Expose net interfaces for PHYs"
	default n
	depends on FSL_DPAA2_MAC
	---help---
	Exposes macX net interfaces which allow direct control over MACs and
	PHYs.
	.
	Leave disabled if unsure.
```

## drivers/staging/media/imx/Kconfig
```kconfig
# SPDX-License-Identifier: GPL-2.0
config VIDEO_IMX_MEDIA
	tristate "i.MX5/6 V4L2 media core driver"
	depends on ARCH_MXC || COMPILE_TEST
	depends on MEDIA_CONTROLLER && VIDEO_V4L2 && IMX_IPUV3_CORE
	depends on VIDEO_V4L2_SUBDEV_API
	depends on HAS_DMA
	select VIDEOBUF2_DMA_CONTIG
	select V4L2_FWNODE
	select V4L2_MEM2MEM_DEV
	help
	  Say yes here to enable support for video4linux media controller
	  driver for the i.MX5/6 SOC.

if VIDEO_IMX_MEDIA
menu "i.MX5/6/7 Media Sub devices"

config VIDEO_IMX_CSI
	tristate "i.MX5/6 Camera Sensor Interface driver"
	depends on VIDEO_IMX_MEDIA && VIDEO_DEV && I2C
	default y
	help
	  A video4linux camera sensor interface driver for i.MX5/6.

config VIDEO_IMX7_CSI
	tristate "i.MX6UL/L / i.MX7 Camera Sensor Interface driver"
	depends on VIDEO_IMX_MEDIA && VIDEO_DEV && I2C
	default y
	help
	  Enable support for video4linux camera sensor interface driver for
	  i.MX6UL/L or i.MX7.
endmenu
endif

config VIDEO_IMX_CAPTURE
	tristate "i.MX V4L2 media core driver"
	depends on ARCH_MXC || COMPILE_TEST
	depends on MEDIA_CONTROLLER && VIDEO_V4L2
	depends on VIDEO_V4L2_SUBDEV_API
	depends on HAS_DMA
	select VIDEOBUF2_DMA_CONTIG
	select V4L2_FWNODE
	help
	  Say yes here to enable support for video4linux media controller
	  driver for the i.MX5/6 SOC.

if VIDEO_IMX_CAPTURE
menu "i.MX8QXP/QM Camera ISI/MIPI Features support"

config IMX8_MEDIA_DEVICE
	tristate "IMX8 Media Device Driver"
	select V4L2_FWNODE
	default y
	help
	  This media device is a virtual device which used to manage
	  all modules in image subsystem of imx8qxp/qm platform.

config IMX8_ISI_CORE
	bool "IMX8 Image Sensor Interface Core Driver"
	depends on VIDEO_V4L2 && VIDEO_V4L2_SUBDEV_API
	default y

config IMX8_ISI_CAPTURE
	bool "IMX8 Image Sensor Interface Capture Device Driver"
	depends on IMX8_ISI_CORE
	select VIDEOBUF2_DMA_CONTIG
	default y

config IMX8_ISI_M2M
	bool "IMX8 Image Sensor Interface Memory to Memory Device Driver"
	select V4L2_MEM2MEM_DEV
	depends on IMX8_ISI_CORE
	default y

config IMX8_MIPI_CSI2
	tristate "IMX8 MIPI CSI2 Controller"
	depends on VIDEO_V4L2 && VIDEO_V4L2_SUBDEV_API
	default y
	help
	  Enable support for video4linux camera sensor interface driver for
	  i.MX8QM/QXP platform.

config IMX8_MIPI_CSI2_SAM
	tristate "IMX8 MIPI CSI2 SAMSUNG Controller"
	depends on VIDEO_V4L2 && VIDEO_V4L2_SUBDEV_API
	default y
	help
	  Enable support for video4linux MIPI CSI2 Samsung driver for
	  i.MX8MN platform.

config IMX8_PARALLEL_CSI
	tristate "IMX8 Parallel Capture Controller"
	depends on VIDEO_V4L2 && VIDEO_V4L2_SUBDEV_API
	default y
	help
	  Enable support for video4linux parallel camera sensor interface
	  driver for i.MX8QM/QXP platform.

config GMSL_MAX9286
	tristate "GMSL MAX8286"
	depends on VIDEO_V4L2 && VIDEO_V4L2_SUBDEV_API
	default y
	help
	  Enable support for video4linux camera sensor driver for GMSL MAX9286

endmenu
endif  #VIDEO_IMX_CAPTURE
```

## drivers/usb/typec/mux/Kconfig
```kconfig
# SPDX-License-Identifier: GPL-2.0

menu "USB Type-C Multiplexer/DeMultiplexer Switch support"

config TYPEC_MUX_PI3USB30532
	tristate "Pericom PI3USB30532 Type-C cross switch driver"
	depends on I2C
	help
	  Say Y or M if your system has a Pericom PI3USB30532 Type-C cross
	  switch / mux chip found on some devices with a Type-C port.

config TYPEC_SWITCH_GPIO
	tristate "Simple Super Speed Active Switch via GPIO"
	help
	  Say Y or M if your system has a typec super speed channel
	  switch via a simple GPIO control.

endmenu
```

## net/tsn/Kconfig
```kconfig
config TSN
	bool "802.1 Time-Sensitive Networking support"
	default n
	depends on VLAN_8021Q && PTP_1588_CLOCK
	help
	  This enables support for TSN(time sensitive networking)
	  TSN features include:
		802.1Qav:
		802.1Qbv:
		802.1Qci:
		802.1Qbu:
		802.1AS:
		802.1CB:

	  If unsure, say N.
```
