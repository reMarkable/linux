// SPDX-License-Identifier: GPL-2.0
//
// Copyright (C) 2013 Freescale Semiconductor, Inc.

#include "imx6dl-sabreauto.dts"

&fec {
	pinctrl-0 = <&pinctrl_enet &pinctrl_enet_irq>;
	interrupts-extended = <&gpio1 6 IRQ_TYPE_LEVEL_HIGH>,
			      <&intc 0 119 IRQ_TYPE_LEVEL_HIGH>;
};

&mlb {
	status = "disabled";
};
