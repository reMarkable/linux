// SPDX-License-Identifier: GPL-2.0+
/*
 * Copyright 2019 NXP
 *	Dong Aisheng <aisheng.dong@nxp.com>
 */

&fec1 {
	compatible = "fsl,imx8qm-fec", "fsl,imx6sx-fec";
};

&fec2 {
	compatible = "fsl,imx8qm-fec", "fsl,imx6sx-fec";
};

&usdhc1 {
	compatible = "fsl,imx8qm-usdhc", "fsl,imx8qxp-usdhc";
};

&usdhc2 {
	compatible = "fsl,imx8qm-usdhc", "fsl,imx8qxp-usdhc";
};
