// SPDX-License-Identifier: GPL-2.0+
/*
 * Copyright 2018-2019 NXP
 *	Dong Aisheng <aisheng.dong@nxp.com>
 */

&usdhc1 {
	compatible = "fsl,imx8qxp-usdhc", "fsl,imx7d-usdhc";
};

&usdhc2 {
	compatible = "fsl,imx8qxp-usdhc", "fsl,imx7d-usdhc";
};

&fec1 {
	compatible = "fsl,imx8qxp-fec", "fsl,imx8qm-fec";
};

&fec2 {
	compatible = "fsl,imx8qxp-fec", "fsl,imx8qm-fec";
};
