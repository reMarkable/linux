## Documentation/devicetree/bindings/display/imx/nxp,imx8mq-dcss.yaml
```yaml
# SPDX-License-Identifier: (GPL-2.0 OR BSD-2-Clause)
# Copyright 2019 NXP
%YAML 1.2
---
$id: "http://devicetree.org/schemas/display/imx/nxp,imx8mq-dcss.yaml#"
$schema: "http://devicetree.org/meta-schemas/core.yaml#"

title: iMX8MQ Display Controller Subsystem (DCSS)

maintainers:
  - Laurentiu Palcu <laurentiu.palcu@nxp.com>

description:

  The DCSS (display controller sub system) is used to source up to three
  display buffers, compose them, and drive a display using HDMI 2.0a(with HDCP
  2.2) or MIPI-DSI. The DCSS is intended to support up to 4kp60 displays. HDR10
  image processing capabilities are included to provide a solution capable of
  driving next generation high dynamic range displays.

properties:
  compatible:
    const: nxp,imx8mq-dcss

  reg:
    maxItems: 2

  interrupts:
    maxItems: 3
    items:
      - description: Context loader completion and error interrupt
      - description: DTG interrupt used to signal context loader trigger time
      - description: DTG interrupt for Vblank

  interrupt-names:
    maxItems: 3
    items:
      - const: ctx_ld
      - const: ctxld_kick
      - const: vblank
      - const: dtrc_ch1
      - const: dtrc_ch2

  clocks:
    maxItems: 5
    items:
      - description: Display APB clock for all peripheral PIO access interfaces
      - description: Display AXI clock needed by DPR, Scaler, RTRAM_CTRL
      - description: RTRAM clock
      - description: Pixel clock, can be driver either by HDMI phy clock or MIPI
      - description: DTRC clock, needed by video decompressor
      - description: PLL source clock, usually VIDEO2_PLL, used when output is HDMI;
      - description: PLL PHY reference clock, used when output is HDMI;

  clock-names:
    items:
      - const: apb
      - const: axi
      - const: rtrm
      - const: pix
      - const: dtrc
      - const: pll_src
      - const: pll_phy_ref

  port@0:
    type: object
    description: A port node pointing to a hdmi_in or mipi_in port node.

examples:
  - |
    dcss: display-controller@32e00000 {
        #address-cells = <1>;
        #size-cells = <0>;
        compatible = "nxp,imx8mq-dcss";
        reg = <0x32e00000 0x2d000>, <0x32e2f000 0x1000>;
        interrupts = <6>, <8>, <9>, <16>, <17>;
        interrupt-names = "ctx_ld", "ctxld_kick", "vblank", "dtrc_ch1", "dtrc_ch2";
        interrupt-parent = <&irqsteer>;
        clocks = <&clk 248>, <&clk 247>, <&clk 249>,
                 <&clk 254>,<&clk 122>, <&clk 266>, <&clk 267>;
        clock-names = "apb", "axi", "rtrm", "pix", "dtrc",
                      "pll_src", "pll_phy_ref";
        assigned-clocks = <&clk 107>, <&clk 109>, <&clk 266>;
        assigned-clock-parents = <&clk 78>, <&clk 78>, <&clk 3>;
        assigned-clock-rates = <800000000>,
                               <400000000>;
        port@0 {
            dcss_out: endpoint {
                remote-endpoint = <&hdmi_in>;
            };
        };
    };
```

## Documentation/devicetree/bindings/i2c/i2c-imx-lpi2c.txt
```
* Freescale Low Power Inter IC (LPI2C) for i.MX

Required properties:
- compatible :
  - "fsl,imx7ulp-lpi2c" for LPI2C compatible with the one integrated on i.MX7ULP soc
- reg : address and length of the lpi2c master registers
- interrupt-parent : core interrupt controller
- interrupts : lpi2c interrupt
- clocks : lpi2c clock specifier

Examples:

lpi2c4: lpi2c4@402B0000 {
	compatible = "fsl,imx7ulp-lpi2c";
	reg = <0x402B0000 0x10000>;
	interrupts = <GIC_SPI 34 IRQ_TYPE_LEVEL_HIGH>;
	clocks = <&clks IMX7ULP_CLK_LPI2C4>;
	clock-names = "ipg";
	assigned-clocks = <&clks IMX7ULP_CLK_LPI2C4>;
	assigned-clock-parents = <&clks IMX7ULP_CLK_FIRC>;
	assigned-clock-rates = <48000000>;
	status = "disabled";
};
```

## Documentation/devicetree/bindings/input/touchscreen/parade-touchscreen.txt
```
pt_i2c_adaptor bindings

Required properties:
- compatible: "parade,pt_i2c_adaptor"
- reg: i2c address of the chip
- interrupt-parent: a phandle for the interrupt controller
- interrupts: Interrupt GPIO
- parade,adapter_id: adaptor name
- core,name: name of core
- core,irq_gpio: IRQ GPIO
- core,hid_desc_register: Default HID register
- core,flags: Special flags
- core,mt,name: name of multi-touch module
- core,mt,inp_dev_name: input device name
- core,mt,flags: MT flags
- core,mt,abs: ABS_MT_* event names

Optional properties:
- core,rst_gpio: Reset GPIO
- core,easy_wakeup_gesture: Default wakeup gesture
- core,panel_id_support: panel ID support
- core,btn_keys: Virtual button key codes
- core,btn_keys-tag: Button Tag
- core,mt,vkeys-x: X coordinate for virtual button area
- core,mt,vkeys-y: Y coordinate for virtual button area
- core,mt,virtual_keys: Keycode CenterX CenterY Width Height

[1]: Documentation/devicetree/bindings/input/parade-touchscreen.txt

Example:
	i2c@0 {
		status = "ok";
		tsc@24 {
			compatible = "parade,pt_i2c_adapter";
			reg = <0x24>;
			interrupt-parent = <&msmgpio>;
			interrupts = <59 0x2>;
			parade,adapter_id = "pt_i2c_adapter";
			pinctrl-names = "pmx_ts_active","pmx_ts_suspend","pmx_ts_release";
			pinctrl-0 = <&ts_int_active>, <&ts_reset_active>;
			pinctrl-1 = <&ts_int_suspend>, <&ts_reset_suspend>;
			pinctrl-2 = <&ts_release>;

			parade,core {
				parade,name = "pt_core";

				parade,irq_gpio = <59>;
				parade,rst_gpio = <13>;
				parade,runfw_gpio = <64>;
				parade,hid_desc_register = <1>;
				/* 
				 * PT_CORE_FLAG_NONE = 0x00
				 * PT_CORE_FLAG_POWEROFF_ON_SLEEP = 0x02
				 * PT_CORE_FLAG_RESTORE_PARAMETERS = 0x04
				 * PT_CORE_FLAG_DEEP_STANDBY = 0x08
				 * PT_CORE_FLAG_SKIP_SYS_SLEEP = 0x10
				 * PT_CORE_FLAG_SKIP_RUNTIME = 0x20
				 * PT_CORE_FLAG_SKIP_RESUME = 0x40
				 */
				parade,flags = <4>;
				/* PT_CORE_EWG_NONE */
				parade,easy_wakeup_gesture = <0>;
				/* 0:AUTO 1:PIP1_ONLY 2:PIP2_CAPABLE*/
				parade,config_dut_generation = <2>;
				/* 0:False 1:True*/
				parade,watchdog_force_stop = <0>;
				/* 
				 * PT_PANEL_ID_DISABLE = 0x00
				 * PT_PANEL_ID_BY_BL = 0x01
				 * PT_PANEL_ID_BY_SYS_INFO = 0x02
				 * PT_PANEL_ID_BY_MFG_DATA  = 0x04
				 */
				parade,panel_id_support = <0>;
				parade,btn_keys = <172 /* KEY_HOMEPAGE */
					   	   /* previously was KEY_HOME, new Android versions use KEY_HOMEPAGE */
				               139 /* KEY_MENU */
				               158 /* KEY_BACK */
				               217 /* KEY_SEARCH */
				               114 /* KEY_VOLUMEDOWN */
				               115 /* KEY_VOLUMEUP */
				               212 /* KEY_CAMERA */
				               116>; /* KEY_POWER */
				parade,btn_keys-tag = <0>;

				parade,mt {
					parade,name = "pt_mt";

					parade,inp_dev_name = "pt_mt";
					/*
					 * PT_MT_FLAG_NONE = 0x00
					 * PT_MT_FLAG_FLIP = 0x08
					 * PT_MT_FLAG_INV_X = 0x10
					 * PT_MT_FLAG_INV_Y = 0x20
					 * PT_MT_FLAG_VKEYS = 0x40
					 */
					parade,flags = <0x00>;
					parade,abs =
						/* ABS_MT_POSITION_X, PT_ABS_MIN_X, PT_ABS_MAX_X, 0, 0 */
						<0x35 0 880 0 0
						/* ABS_MT_POSITION_Y, PT_ABS_MIN_Y, PT_ABS_MAX_Y, 0, 0 */
						0x36 0 1280 0 0
						/* ABS_MT_PRESSURE, PT_ABS_MIN_P, PT_ABS_MAX_P, 0, 0 */
						0x3a 0 255 0 0
						/* PT_IGNORE_VALUE, PT_ABS_MIN_W, PT_ABS_MAX_W, 0, 0 */
						0xffff 0 255 0 0
						/* ABS_MT_TRACKING_ID, PT_ABS_MIN_T, PT_ABS_MAX_T, 0, 0 */
						0x39 0 15 0 0
						/* ABS_MT_TOUCH_MAJOR, 0, 255, 0, 0 */
						0x30 0 255 0 0
						/* ABS_MT_TOUCH_MINOR, 0, 255, 0, 0 */
						0x31 0 255 0 0
						/* ABS_MT_ORIENTATION, -127, 127, 0, 0 */
						0x34 0xffffff81 127 0 0
						/* ABS_MT_TOOL_TYPE, 0, MT_TOOL_MAX, 0, 0 */
						0x37 0 1 0 0
						/* ABS_DISTANCE, 0, 255, 0, 0 */
						0x19 0 255 0 0>;

					parade,vkeys_x = <720>;
					parade,vkeys_y = <1280>;

					parade,virtual_keys = /* KeyCode CenterX CenterY Width Height */
						/* KEY_BACK */
						<158 90 1360 160 180
						/* KEY_MENU */
						139 270 1360 160 180
						/* KEY_HOMEPAGE */
						172 450 1360 160 180
						/* KEY SEARCH */
						217 630 1360 160 180>;
				};
			};
		};
	};
```

## Documentation/devicetree/bindings/media/imx8-jpeg.txt
```
Freescale i.MX8QXP/QM JPEG encoder/decoder
=========================

jpegdec node
--------------

This is the device node for the JPEG decoder in i.MXQXP/QM SoC, an
ISO/IEC 10918-1 JPEG standard compliant decoder, for Baseline
and Extended Sequential DCT modes.

Required properties:

- compatible    : "fsl,imx8-jpgdec";
- reg           : base address and length of the register set for the device;
- interrupts    : list of interrupts for jpeg decoder
- clocks        : list of clock specifiers, see
        Documentation/devicetree/bindings/clock/clock-bindings.txt for details;
- assigned-clock-rates : the value should be 200MHz;
- power-domains : a list of phandle to the power domain, see
          Documentation/devicetree/bindings/power/power_domain.txt for details;


Optional properties:
- clock-names   : must contain clock names to match entries in the
                  clock property;
- power-domain-name : must contain matching names for  entries in the
                      the power-domains property.


example:

		jpegdec: jpegdec@58400000 {
			compatible = "fsl,imx8-jpgdec";
			reg = <0x58400000 0x00050000 >;
			interrupts = <GIC_SPI 309 IRQ_TYPE_LEVEL_HIGH>,
				     <GIC_SPI 310 IRQ_TYPE_LEVEL_HIGH>,
				     <GIC_SPI 311 IRQ_TYPE_LEVEL_HIGH>,
				     <GIC_SPI 312 IRQ_TYPE_LEVEL_HIGH>;
			clocks = <&img_jpeg_dec_clk 0>,
				 <&img_jpeg_dec_clk 1>;
			clock-names = "per", "ipg";
			assigned-clocks = <&img_jpeg_dec_clk 0>,
					  <&img_jpeg_dec_clk 1>;
			assigned-clock-rates = <200000000>;
			power-domains = <&pd IMX_SC_R_ISI_CH0>,
					<&pd IMX_SC_R_MJPEG_DEC_MP>,
					<&pd IMX_SC_R_MJPEG_DEC_S0>,
					<&pd IMX_SC_R_MJPEG_DEC_S1>,
					<&pd IMX_SC_R_MJPEG_DEC_S2>,
					<&pd IMX_SC_R_MJPEG_DEC_S3>;
			power-domain-names = "pd_isi_ch0", "pd_dec_mp",
					     "pd_dec_s0", "pd_dec_s1",
					     "pd_dec_s2", "pd_dec_s3";
			status = "disabled";


jpegenc node
--------------

This is the device node for the JPEG encoder in i.MXQXP/QM SoC,
similar with the JPEG decoder above.

Required properties:

- compatible    : "fsl,imx8-jpgenc";
- reg           : base address and length of the register set for the device;
- interrupts    : list of interrupts for jpeg encoder
- clocks        : list of clock specifiers, see
        Documentation/devicetree/bindings/clock/clock-bindings.txt for details;
- assigned-clock-rates : the value should be 200MHz;
- power-domains : a list of phandle to the power domain, see
          Documentation/devicetree/bindings/power/power_domain.txt for details;


Optional properties:
- clock-names   : must contain clock names to match entries in the
                  clock property;
- power-domain-name : must contain matching names for  entries in the
                      the power-domains property.


example:

		jpegenc: jpegenc@58450000 {
			compatible = "fsl,imx8-jpgenc";
			reg = <0x58450000 0x00050000 >;
			interrupts = <GIC_SPI 305 IRQ_TYPE_LEVEL_HIGH>,
				     <GIC_SPI 306 IRQ_TYPE_LEVEL_HIGH>,
				     <GIC_SPI 307 IRQ_TYPE_LEVEL_HIGH>,
				     <GIC_SPI 308 IRQ_TYPE_LEVEL_HIGH>;
			clocks = <&img_jpeg_enc_clk 0>,
				 <&img_jpeg_enc_clk 1>;
			clock-names = "per", "ipg";
			assigned-clocks = <&img_jpeg_enc_clk 0>,
					  <&img_jpeg_enc_clk 1>;
			assigned-clock-rates = <200000000>;
			power-domains = <&pd IMX_SC_R_ISI_CH0>,
					<&pd IMX_SC_R_MJPEG_ENC_MP>,
					<&pd IMX_SC_R_MJPEG_ENC_S0>,
					<&pd IMX_SC_R_MJPEG_ENC_S1>,
					<&pd IMX_SC_R_MJPEG_ENC_S2>,
					<&pd IMX_SC_R_MJPEG_ENC_S3>;
			power-domain-names = "pd_isi_ch0", "pd_enc_mp",
					     "pd_enc_s0", "pd_enc_s1",
					     "pd_enc_s2", "pd_enc_s3";
			status = "disabled";
		};
```

## Documentation/devicetree/bindings/media/imx8-mipi-csi.txt
```
Freescale i.MX8QXP/QM MIPI CSI2
=========================

mipi_csi2 node
--------------

This is the device node for the MIPI CSI-2 receiver core in i.MXQXP/QM SoC.

Required properties:

- compatible    : "fsl,mxc-mipi-csi2";
- reg           : base address and length of the register set for the device;
- clocks        : list of clock specifiers, see
        Documentation/devicetree/bindings/clock/clock-bindings.txt for details;
- clock-names   : must contain "clk_core", "clk_esc" and "clk_pxl" entries,
                  matching entries in the clock property;
- assigned-clock-rates : the value should be 360MHz and 72MHz;
- power-domains : a phandle to the power domain, see
          Documentation/devicetree/bindings/power/power_domain.txt for details;
- power-domain-name : must contain "pd_csi", "pd_isi_ch0".

Optional properties:
- virtual-channel: whether use mipi csi virtual channel

The device node should contain one 'port' child nodes with one child 'endpoint'
node, according to the bindings defined in:
 Documentation/devicetree/bindings/ media/video-interfaces.txt.
 The following are properties specific to those nodes.

port node
---------

- reg		  : (required) can take the values 0 which mean the port is a
		    sink port;

endpoint node
-------------

- data-lanes    : (required) an array specifying active physical MIPI-CSI2
		    data input lanes and their mapping to logical lanes; this
                    shall only be applied to port 0 (sink port), the array's
                    content is unused only its length is meaningful,
                    in this case the maximum length supported is 2;

example:

        mipi_csi: csi@58227000 {
                #address-cells = <1>;
                #size-cells = <0>;

                compatible = "fsl,mxc-mipi-csi2";
                reg = <0x58227000 0x1000>,
                      <0x58221000 0x1000>;
                clocks = <&csi_lpcg IMX_CSI_LPCG_CSI0_CORE_CLK>,
                         <&csi_lpcg IMX_CSI_LPCG_CSI0_ESC_CLK>,
                         <&img_lpcg IMX_IMG_LPCG_CSI0_PXL_LINK_CLK>;
                clock-names = "clk_core", "clk_esc", "clk_pxl";
                assigned-clocks = <&csi_lpcg IMX_CSI_LPCG_CSI0_CORE_CLK>,
                                  <&csi_lpcg IMX_CSI_LPCG_CSI0_ESC_CLK>;
                assigned-clock-rates = <360000000>, <72000000>;
                power-domains = <&pd IMX_SC_R_CSI_0>, <&pd IMX_SC_R_ISI_CH0>;
                power-domain-names = "pd_csi", "pd_isi_ch0";
                status = "okay";

                port@0 {
                        reg = <0>;
                        mipi_csi0_ep: endpoint {
                                remote-endpoint = <&ov5640_mipi_ep>;
                                data-lanes = <1 2>;
                        };
                };

        };
```
