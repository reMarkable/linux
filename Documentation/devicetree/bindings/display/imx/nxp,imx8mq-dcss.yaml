## Documentation/devicetree/bindings/media/imx8-parallel-csi.txt
```
Freescale i.MX8QXP Parallel Capture Interface
=========================

parallel interface node
--------------

This is the device node for the parallel capture interface in i.MX8QXP SoC.

Required properties:
- compatible    : "fsl,mxc-parallel-csi";
- reg           : base address and length of the register set for the device;
- clocks        : list of clock specifiers
- clock-names   : must contain "pixel", "ipg", "div" and "dpll" entries,
                  matching entries in the clock property;
- assigned-clocks      : need to set the parent of pixel clock;
- assigned-clock-parent: set the pll as the parent of pixel clock;
- assigned-clock-rates : the value should be 160MHz;
- power-domains : a phandle to the power domain, see
- power-domain-name : must contain "pd_pi", "pd_isi_ch0".

port node
- reg  :  can take the values 0 which mean the port is a sink port

example:
		parallel_csi: pcsi@58261000 {
			#address-cells = <1>;
			#size-cells = <0>;

			compatible = "fsl,mxc-parallel-csi";
			reg = <0x58261000 0x1000>;
			clocks = <&pi_lpcg IMX_PI_LPCG_PI0_PIXEL_CLK>,
				 <&pi_lpcg IMX_PI_LPCG_PI0_IPG_CLK>,
				 <&clk IMX_PARALLEL_PER_DIV_CLK>,
				 <&clk IMX_PARALLEL_DPLL_CLK>;
			clock-names = "pixel", "ipg", "div", "dpll";
			assigned-clocks = <&clk IMX_PARALLEL_PER_DIV_CLK>;
			assigned-clock-parents = <&clk IMX_PARALLEL_DPLL_CLK>;
			assigned-clock-rates = <160000000>;  /* 160MHz */
			power-domains = <&pd IMX_SC_R_PI_0>, <&pd IMX_SC_R_ISI_CH0>;
			power-domain-names = "pd_pi", "pd_isi_ch0";

			port@0 {
				reg = <0>;
				parallel_csi_ep: endpoint {
					remote-endpoint = <&ov5640_ep>;
				};
			};
		};
```

## Documentation/devicetree/bindings/net/can/fsl-flexcan.txt
```
Flexcan CAN controller on Freescale's ARM and PowerPC system-on-a-chip (SOC).

Required properties:

- compatible : Should be "fsl,<processor>-flexcan"

  An implementation should also claim any of the following compatibles
  that it is fully backwards compatible with:

  - fsl,p1010-flexcan

- reg : Offset and length of the register set for this device
- interrupts : Interrupt tuple for this device

Clocking information is must for flexcan. please refer below info for
understanding clocking in flexcan:

• The FLEXCAN module is divided into two blocks. Controller host interface
  ("CHI") and Protocol Engine ("PE")
• Both these blocks require clock.
• CHI is responsible for registers read write including MB read/write.
  While PE is responsible for Transfer/receive data on CAN bus.
• The clocks feeding to these two blocks can be synchronous (i.e. same clock)
  or asynchronous (i.e. separate clocks).
• Selection is made in the CLK_SRC bit (bit 13) of Control 1 Register.
  - CLK_SRC = 0, asynchronous i.e. separate clocks for CHI and PE
  - CLK_SRC = 1, synchronous i.e. CHI clock is used for PE and PE
                 clock is not used.
• If this bit is not implemented in SOC, then SOC only supports asynchronous
  clocks.
• Either of the clock can be generated by any of the clock source.
• When the two clocks are asynchronous, then following restrictions apply to
  PE clock.
  - PE clock must be less than CHI clock.
• If low jitter is required on CAN bus, dedicated oscillator can be used to
  provide PE clock, but it must be less than CHI clock.

Base on above information clocking info in flexcan can be defined in two ways:

Method 1(Preferred):
  - clocks: phandle to the clocks feeding the flexcan. Two can be given:
    - "ipg": Protocol Engine clock
    - "per": Controller host interface clock
  - clock-names: Must contain the clock names described just above.

Method 2(Not Preferred):
  - clock-frequency : The synchronous clock frequency supplied to both
  Controller host interface and Protocol Engine

Optional properties:

- xceiver-supply: Regulator that powers the CAN transceiver

- big-endian: This means the registers of FlexCAN controller are big endian.
              This is optional property.i.e. if this property is not present in
              device tree node then controller is assumed to be little endian.
              if this property is present then controller is assumed to be big
              endian.

- fsl,stop-mode: register bits of stop mode control, the format is
		 <&gpr req_gpr req_bit ack_gpr ack_bit>.
		 gpr is the phandle to general purpose register node.
		 req_gpr is the gpr register offset of CAN stop request.
		 req_bit is the bit offset of CAN stop request.
		 ack_gpr is the gpr register offset of CAN stop acknowledge.
		 ack_bit is the bit offset of CAN stop acknowledge.

- fsl,clk-source: Select the clock source to the CAN Protocol Engine (PE).
		  It's SoC Implementation dependent. Refer to RM for detailed
		  definition. If this property is not set in device tree node
		  then driver selects clock source 1 by default.
		  0: clock source 0 (oscillator clock)
		  1: clock source 1 (peripheral clock)

- wakeup-source: enable CAN remote wakeup

Example:

	can@1c000 {
		compatible = "fsl,p1010-flexcan";
		reg = <0x1c000 0x1000>;
		interrupts = <48 0x2>;
		interrupt-parent = <&mpic>;
		clock-frequency = <200000000>; // filled in by bootloader
		fsl,clk-source = <0>; // select clock source 0 for PE
	};

	can@2180000 {
		compatible = "fsl,lx2160ar1-flexcan";
		reg = <0x0 0x2180000 0x0 0x10000>;
		interrupts = <GIC_SPI 21 IRQ_TYPE_LEVEL_HIGH>;
		clocks = <&sysclk>, <&clockgen 4 7>;
		clock-names = "ipg", "per";
		status = "disabled";
	};
```

## Documentation/devicetree/bindings/net/realtek.txt
```
Realtek PHY properties.

These properties cover the base properties Realtek PHYs.

Optional properties:
 - rtl821x,clkout_en : enable clkout to supply clocks for MAC.
```

## Documentation/devicetree/bindings/phy/fsl,imx-pcie-phy.txt
```
* Freescale i.MX PCIE PHY binding

Required properties:
- compatible:	Should be "fsl,imx-pcie-phy"
- #phys-cells:	must be 0 (see phy-bindings.txt in this directory)
- reg:		The base address and length of the registers
- clocks:	Phandles to the clocks for each clock listed in clock-names
- clock-names:	Must contain "phy"
- ext_osc:	Specify the reference clock source. 1: external oscilltor is
  used as PCIe reference clock. 0: internal PLL is used.
- power-domains: Phandle to the power domain that the device is part of

Example:
	pcie_phy: pcie-phy@32f00000 {
		compatible = "fsl,imx8mp-pcie-phy";
		reg = <0x0 0x32f00000 0x0 0x10000>;
		clocks = <&clk IMX8MP_CLK_PCIE_PHY>;
		clock-names = "phy";
		assigned-clocks = <&clk IMX8MP_CLK_PCIE_PHY>;
		assigned-clock-parents = <&clk IMX8MP_CLK_24M>;
		#phy-cells = <0>;
		power-domains = <&pcie_pd>;
		status = "disabled";
	};
```

## Documentation/devicetree/bindings/pinctrl/fsl,imx8mp-pinctrl.txt
```
* Freescale IMX8MP IOMUX Controller

Please refer to fsl,imx-pinctrl.txt and pinctrl-bindings.txt in this directory
for common binding part and usage.

Required properties:
- compatible: "fsl,imx8mp-iomuxc"
- reg: should contain the base physical address and size of the iomuxc
  registers.

Required properties in sub-nodes:
- fsl,pins: each entry consists of 6 integers and represents the mux and config
  setting for one pin.  The first 5 integers <mux_reg conf_reg input_reg mux_val
  input_val> are specified using a PIN_FUNC_ID macro, which can be found in
  <arch/arm64/boot/dts/freescale/imx8mp-pinfunc.h>. The last integer CONFIG is
  the pad setting value like pull-up on this pin. Please refer to i.MX8M Plus
  Reference Manual for detailed CONFIG settings.

Examples:

&uart1 {
       pinctrl-names = "default";
       pinctrl-0 = <&pinctrl_uart1>;
};

iomuxc: pinctrl@30330000 {
        compatible = "fsl,imx8mp-iomuxc";
        reg = <0x30330000 0x10000>;

	pinctrl_uart1: uart1grp {
		fsl,pins = <
			MX8MP_IOMUXC_UART1_RXD__UART1_DCE_RX    0x140
			MX8MP_IOMUXC_UART1_TXD__UART1_DCE_TX    0x140
			MX8MP_IOMUXC_UART3_RXD__UART1_DCE_CTS   0x140
			MX8MP_IOMUXC_UART3_TXD__UART1_DCE_RTS   0x140
		>;
	};
};
```

## Documentation/devicetree/bindings/power/supply/max77818_battery.txt
```
max77818_battery
~~~~~~~~~~~~~~~~

Required properties :
 - compatible : "maxim,max77818"

Optional properties :
 - maxim,rsns-microohm : Resistance of rsns resistor in micro Ohms
                         (datasheet-recommended value is 10000).
   Defining this property enables current-sense functionality.

Optional threshold properties :
 If skipped the condition won't be reported.
 - maxim,cold-temp :      Temperature threshold to report battery
                          as cold (in tenths of degree Celsius).
 - maxim,over-heat-temp : Temperature threshold to report battery
                          as over heated (in tenths of degree Celsius).
 - maxim,dead-volt :      Voltage threshold to report battery
                          as dead (in mV).
 - maxim,over-volt :      Voltage threshold to report battery
                          as over voltage (in mV).
 - maxim,min-soc-alert :  Threshold to report SOC as low (in %).
                          SOC at this level will cause the min SOC
                          alert to be disabled and the max SOC alert
                          to be enabled.
 - maxim,max-soc-alert :  Threshold to report SOC as high (in %).
                          SOC at this level will cause the max SOC
                          alert to be disabled and the min SOC alert
                          to be enabled

Example:

	battery-charger@36 {
		compatible = "maxim,max77818";
		reg = <0x36>;
		maxim,rsns-microohm = <10000>;
		maxim,over-heat-temp = <600>;
		maxim,over-volt = <4300>;
		maxim,min-soc-alert = <10>;
		maxim,max-soc-alert = <12>;
	};
```

## Documentation/devicetree/bindings/remoteproc/imx-rproc.yaml
```yaml
# SPDX-License-Identifier: (GPL-2.0 OR BSD-2-Clause)
%YAML 1.2
---
$id: "http://devicetree.org/schemas/remoteproc/imx-rproc.yaml#"
$schema: "http://devicetree.org/meta-schemas/core.yaml#"

title: NXP iMX6SX/iMX7D Co-Processor Bindings

description:
  This binding provides support for ARM Cortex M4 Co-processor found on
  some NXP iMX SoCs.

maintainers:
  - Oleksij Rempel <o.rempel@pengutronix.de>
  - Peng Fan <peng.fan@nxp.com>

properties:
  compatible:
      enum:
        - "fsl,imx7d-cm4"
        - "fsl,imx6sx-cm4"

  clocks:
    items:
      Clock for co-processor (See: ../clock/clock-bindings.txt)

  syscon:
     description:
       Phandle to syscon block which provide access to System Reset Controller
     allOf:
       - $ref: "/schemas/types.yaml#/definitions/phandle"

  memory-region:
    description:
      List of phandles to the reserved memory regions.
      (see ../reserved-memory/reserved-memory.txt)

required:
  - compatible
  - clocks
  - syscon

examples:
  - |
    #include <dt-bindings/clock/imx7d-clock.h>
    m4_reserved_sysmem1: cm4@80000000 {
        reg = <0x80000000 0x80000>;
    };

    m4_reserved_sysmem2: cm4@81000000 {
        reg = <0x81000000 0x80000>;
    };

    imx7d-cm4 {
        compatible  = "fsl,imx7d-cm4";
        memory-region = <&m4_reserved_sysmem1>, <&m4_reserved_sysmem2>;
        syscon = <&src>;
        clocks = <&clks IMX7D_ARM_M4_ROOT_CLK>;
    };

...
```

## Documentation/devicetree/bindings/sound/fsl,aud2htx.txt
```
fsl,aud2htx The AUD2HTX is a digital module that provides a bridge between
the Audio Subsystem and the HDMI RTX Subsystem.

Required properties:

- compatible:       Must contain one of "fsl,imx8mp-aud2htx".
- reg:              Offset and length of the register set for the device.
- interrupts:       <a b> where a is the interrupt number and b is a
                    field that represents an encoding of the sense and
                    level information for the interrupt.  This should be
                    encoded based on the information in section 2)
                    depending on the type of interrupt controller you
                    have.
- clocks:           A list of phandles + clock-specifiers, one for each
		    entry in clock-names
- clock-names:      Must contain "bus"

Optional properties:
- dmas:		    Generic dma devicetree binding as described in
		    Documentation/devicetree/bindings/dma/dma.txt.
- dma-names:	    One dmas have to be defined, "tx".

Example:

aud2htx: aud2htx@30cb0000 {
	compatible = "fsl,imx8mp-aud2htx";
	reg = <0x30cb0000 0x10000>;
	interrupts = <GIC_SPI 130 IRQ_TYPE_LEVEL_HIGH>;
	clocks = <&audiomix_clk IMX8MP_CLK_AUDIOMIX_AUD2HTX_IPG>;
	clock-names = "bus";
	dmas = <&sdma2 26 2 0>;
	dma-names = "tx";
	power-domains = <&audiomix_pd>;
	status = "disabled";
};
```

## Documentation/devicetree/bindings/sound/fsl,dsp,lpa.txt
```
NXP LPA(Low Power Audio) DSP

The DTS is for i.MX8MP DSP offload audio playback. DSP only use OCRAM
and OCRAM_A when audio playback, so DRAM can enter retention mode to
save Power. As the size limitation of OCRAM and OCRAM_A and the size
audio decoder library, the LPA playback only can support MP3.
OCRAM address is 0x900000-0x990000. ATF will use 0x960000-0x980000.
DSP LPA will use ocram(0x900000-0x960000) and ocram_e(0x980000-
0x990000)

Required properties:

  - compatible			: Contains "fsl,imx8mp-dsp-lpa".
  - fsl,dsp-firmware		: LPA DSP FW name.

Example:

&dsp {
	compatible = "fsl,imx8mp-dsp-lpa";
	ocram = <&ocram>;
	ocram-e = <&ocram_e>;
	fsl,dsp-firmware = "imx/dsp/hifi4_imx8mp_lpa.bin";
	status = "okay";
};
```

## Documentation/devicetree/bindings/spi/spi-fsl-lpspi.txt
```
* Freescale Low Power SPI (LPSPI) for i.MX

Required properties:
- compatible :
  - "fsl,imx7ulp-spi" for LPSPI compatible with the one integrated on i.MX7ULP soc
  - "fsl,imx8qxp-spi" for LPSPI compatible with the one integrated on i.MX8QXP soc
- reg : address and length of the lpspi master registers
- interrupt-parent : core interrupt controller
- interrupts : lpspi interrupt
- clocks : lpspi clock specifier. Its number and order need to correspond to the
	   value in clock-names.
- clock-names : Corresponding to per clock and ipg clock in "clocks"
		respectively. In i.MX7ULP, it only has per clk, so use CLK_DUMMY
		to fill the "ipg" blank.
- spi-slave : spi slave mode support. In slave mode, add this attribute without
	      value. In master mode, remove it.
- fsl,spi-only-use-cs1-sel : spi common code does not support use of CS signals
			     discontinuously. i.MX8DXL-EVK board only uses CS1
			     without using CS0. Therefore, add this property to
			     re-config the chipselect value in the LPSPI driver.

Examples:

lpspi2: lpspi@40290000 {
	compatible = "fsl,imx7ulp-spi";
	reg = <0x40290000 0x10000>;
	interrupt-parent = <&intc>;
	interrupts = <GIC_SPI 28 IRQ_TYPE_LEVEL_HIGH>;
	clocks = <&clks IMX7ULP_CLK_LPSPI2>,
		 <&clks IMX7ULP_CLK_DUMMY>;
	clock-names = "per", "ipg";
	spi-slave;
};
```
